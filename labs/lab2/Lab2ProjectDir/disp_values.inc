; 0-1-1-1--0-1-1-1
; 0x77
.equ ZERO_DISP = 0x77

; 0-0-0-0--0-1-1-0
; 0x06
.equ ONE_DISP = 0x06

; 1-0-1-1--0-0-1-1
; 0xB3
.equ TWO_DISP = 0xB3

;1-0-0-1--0-1-1-1
;1-0-0-1--0-1-1-1
; 0x97
.equ THREE_DISP = 0x97

; 1-1-0-0--0-1-1-0
; 0xC6
.equ FOUR_DISP = 0xC6

; 1-1-0-1--0-1-0-1
; 0xD5
.equ FIVE_DISP = 0xD5

; 1-1-1-1--0-1-0-1
; 0xF5
.equ SIX_DISP = 0xF5

; 0-0-0-0--0-1-1-1
; 0x07
.equ SEVEN_DISP = 0x07

; 1-1-1-1--0-1-1-1
; 0xF7
.equ EIGHT_DISP = 0xF7

; 1-1-0-1--0-1-1-1
; 0xD7
.equ NINE_DISP = 0xD7

; 1-1-1-0--0-1-1-1
; 0xE7
.equ A_DISP = 0xE7

; 1-1-1-1--0-1-0-0
; 0xF4
.equ B_DISP = 0xF4

; 0-1-1-1--0-0-0-1
; 0x71
.equ C_DISP = 0x71

; 1-0-1-1--0-1-1-0
; 0xB6
.equ D_DISP = 0xB6

; 1-1-1-1--0-0-0-1
; 0xF1
.equ E_DISP = 0xF1

; 1-1-1-0--0-0-0-1
; 0xE1
.equ F_DISP = 0xE1
